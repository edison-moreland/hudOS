## buildroot/Config.in
```kconfig
source "$BR2_EXTERNAL_HUDOS_PATH/package/hudOS/Config.in"
source "$BR2_EXTERNAL_HUDOS_PATH/package/hudOS-network/Config.in"
source "$BR2_EXTERNAL_HUDOS_PATH/package/hudOS-deploy-user/Config.in"
source "$BR2_EXTERNAL_HUDOS_PATH/package/hudOS-first-boot/Config.in"
source "$BR2_EXTERNAL_HUDOS_PATH/package/envsubst/Config.in"
source "$BR2_EXTERNAL_HUDOS_PATH/package/hudctl/Config.in"
source "$BR2_EXTERNAL_HUDOS_PATH/package/pine-firmware/Config.in"
source "$BR2_EXTERNAL_HUDOS_PATH/package/kiwmi/Config.in"
```

## buildroot/br2_hudos/Config.in
```kconfig
source "$BR2_EXTERNAL_HUDOS_PATH/package/hud-deploy-user/Config.in"
source "$BR2_EXTERNAL_HUDOS_PATH/package/hud-network/Config.in"
source "$BR2_EXTERNAL_HUDOS_PATH/package/hud-ui/Config.in"
source "$BR2_EXTERNAL_HUDOS_PATH/package/pine-firmware/Config.in"
source "$BR2_EXTERNAL_HUDOS_PATH/package/hudctl/Config.in"
source "$BR2_EXTERNAL_HUDOS_PATH/package/hud-first-boot/Config.in"
```

## buildroot/br2_hudos/configs/hudos_defconfig
```kconfig
BR2_aarch64=y
BR2_TOOLCHAIN_EXTERNAL=y
BR2_CCACHE=y
BR2_TARGET_GENERIC_HOSTNAME="hudOS"
BR2_TARGET_GENERIC_ISSUE="Welcome to hudOS"
BR2_INIT_SYSTEMD=y
# BR2_TARGET_ENABLE_ROOT_LOGIN is not set
BR2_SYSTEM_BIN_SH_BASH=y
# BR2_TARGET_GENERIC_GETTY is not set
BR2_ROOTFS_POST_IMAGE_SCRIPT="support/scripts/genimage.sh"
BR2_ROOTFS_POST_SCRIPT_ARGS="-c $(BR2_EXTERNAL_HUDOS_PATH)/board/pine64/pinephone/genimage.cfg"
BR2_LINUX_KERNEL=y
BR2_LINUX_KERNEL_CUSTOM_GIT=y
BR2_LINUX_KERNEL_CUSTOM_REPO_URL="https://github.com/megous/linux.git"
BR2_LINUX_KERNEL_CUSTOM_REPO_VERSION="orange-pi-6.0"
BR2_LINUX_KERNEL_DEFCONFIG="pinephone"
BR2_LINUX_KERNEL_IMAGEGZ=y
BR2_LINUX_KERNEL_DTS_SUPPORT=y
BR2_LINUX_KERNEL_INTREE_DTS_NAME="allwinner/sun50i-a64-pinephone-1.2 allwinner/sun50i-a64-pinephone-1.1 allwinner/sun50i-a64-pinephone-1.0"
BR2_PACKAGE_FLEX=y
BR2_PACKAGE_MESA3D=y
BR2_PACKAGE_MESA3D_GALLIUM_DRIVER_LIMA=y
BR2_PACKAGE_MESA3D_OPENGL_EGL=y
BR2_PACKAGE_MESA3D_OPENGL_ES=y
BR2_PACKAGE_WESTON=y
# BR2_PACKAGE_WESTON_SHELL_FULLSCREEN is not set
# BR2_PACKAGE_WESTON_SHELL_KIOSK is not set
BR2_PACKAGE_LINUX_FIRMWARE=y
BR2_PACKAGE_LINUX_FIRMWARE_BRCM_BCM43XXX=y
BR2_PACKAGE_DBUS_GLIB=y
BR2_PACKAGE_LVM2=y
BR2_PACKAGE_GNUTLS=y
BR2_PACKAGE_LIBARGON2=y
BR2_PACKAGE_LIBGUDEV=y
BR2_PACKAGE_LIBUSB=y
BR2_PACKAGE_JSON_C=y
BR2_PACKAGE_LIBFASTJSON=y
BR2_PACKAGE_LIBLOGGING=y
BR2_PACKAGE_LIBNDP=y
BR2_PACKAGE_LIBESTR=y
BR2_PACKAGE_LIBFRIBIDI=y
BR2_PACKAGE_IPUTILS=y
BR2_PACKAGE_OPENSSH=y
BR2_PACKAGE_RSYNC=y
BR2_PACKAGE_WIRELESS_REGDB=y
BR2_PACKAGE_WPA_SUPPLICANT=y
BR2_PACKAGE_WPA_SUPPLICANT_WPA3=y
BR2_PACKAGE_WPA_SUPPLICANT_DBUS=y
BR2_PACKAGE_BASH_COMPLETION=y
BR2_PACKAGE_SUDO=y
BR2_PACKAGE_TIME=y
BR2_PACKAGE_WHICH=y
BR2_PACKAGE_SYSTEMD_BACKLIGHT=y
BR2_PACKAGE_TAR=y
BR2_PACKAGE_UTIL_LINUX_LIBFDISK=y
BR2_PACKAGE_UTIL_LINUX_HWCLOCK=y
BR2_PACKAGE_VIM=y
BR2_TARGET_ROOTFS_EXT2=y
BR2_TARGET_ROOTFS_EXT2_4=y
BR2_TARGET_ROOTFS_EXT2_SIZE="200M"
# BR2_TARGET_ROOTFS_TAR is not set
BR2_PACKAGE_HOST_DTC=y
BR2_PACKAGE_HOST_GENIMAGE=y
BR2_PACKAGE_HOST_MTOOLS=y
BR2_PACKAGE_HOST_UBOOT_TOOLS=y
BR2_PACKAGE_HOST_UBOOT_TOOLS_BOOT_SCRIPT=y
BR2_PACKAGE_HOST_UBOOT_TOOLS_BOOT_SCRIPT_SOURCE="$(BR2_EXTERNAL_HUDOS_PATH)/board/pine64/pinephone/boot.txt"
BR2_PACKAGE_HUD_NETWORK=y
BR2_PACKAGE_HUD_UI=y
BR2_PACKAGE_PINE_FIRMWARE=y
BR2_PACKAGE_PINE_FIRMWARE_ANX7688=y
BR2_PACKAGE_PINE_FIRMWARE_OV5640=y
BR2_PACKAGE_PINE_FIRMWARE_RTL8723CS=y
```

## buildroot/br2_hudos/package/bcc/Config.in
```kconfig
config BR2_PACKAGE_BCC
    bool "bcc"
    depends on BR2_TOOLCHAIN_HEADERS_AT_LEAST_4_13
    depends on BR2_PACKAGE_LLVM
    depends on BR2_PACKAGE_LLVM_BPF
    depends on BR2_PACKAGE_CLANG
    select BR2_PACKAGE_XZ
    select BR2_PACKAGE_LIBBPF
    help
        BPF Compiler Collection

comment "bcc needs clang & llvm(w/bpf)"
    depends on !BR2_PACKAGE_LLVM
    depends on !BR2_PACKAGE_LLVM_BPF
    depends on !BR2_PACKAGE_CLANG
```

## buildroot/br2_hudos/package/bpftrace/Config.in
```kconfig
config BR2_PACKAGE_BPFTRACE
    bool "bpftrace"
    depends on BR2_PACKAGE_BCC
    depends on BR2_PACKAGE_BINUTILS
    select BR2_PACKAGE_LIBBPF
    select BR2_PACKAGE_CEREAL
    select BR2_PACKAGE_LIBPCAP
    help
        BPF Trace


comment "bpf trace needs bcc + binutils"
    depends on !BR2_PACKAGE_BCC
    depends on !BR2_PACKAGE_BINUTILS
```

## buildroot/br2_hudos/package/hud-deploy-user/Config.in
```kconfig
config BR2_PACKAGE_HUD_DEPLOY_USER
    bool "hud deploy user"
    help
        Create user account and ssh key for hud development
```

## buildroot/br2_hudos/package/hud-first-boot/Config.in
```kconfig
config BR2_PACKAGE_HUD_FIRST_BOOT
	bool "first-boot"
	depends on BR2_PACKAGE_HUD_UI
	help
	    Runs all scripts under /opt/hud/first-boot when hudOS boots for the first time
```

## buildroot/br2_hudos/package/hud-landing-pad/Config.in
```kconfig
config BR2_PACKAGE_HUD_LANDING_PAD
    bool "hud landing pad"
    depends on BR2_PACKAGE_SYSTEMD
    help
        Setup everything needed to deploy hud after the system boots.
        Eventually the deploy will also be included in buildroot.

if BR2_PACKAGE_HUD_LANDING_PAD
config BR2_PACKAGE_HUD_LANDING_PAD_WIFI_SSID
    string
    prompt "SSID"
    help
        SSID for network

config BR2_PACKAGE_HUD_LANDING_PAD_WIFI_PASSWORD
    string
    prompt "Password"
    help
        Password for network

config BR2_PACKAGE_HUD_LANDING_PAD_DEPLOY_USER
    bool "Create deploy user + ssh key"
    help
        Creates deploy user and ssh key for development.
        Deploy user is used to live update the user interface.
endif
```

## buildroot/br2_hudos/package/hud-network/Config.in
```kconfig
config BR2_PACKAGE_HUD_NETWORK
    bool "hud network"
    depends on BR2_PACKAGE_SYSTEMD
    help
        Auto join WiFi

if BR2_PACKAGE_HUD_NETWORK
config BR2_PACKAGE_HUD_NETWORK_WIFI_SSID
    string
    prompt "SSID"
    help
        SSID for network

config BR2_PACKAGE_HUD_NETWORK_WIFI_PSK
    string
    prompt "Password"
    help
        Password for network

endif
```

## buildroot/br2_hudos/package/hud-ui/Config.in
```kconfig
config BR2_PACKAGE_HUD_UI
    bool "hud ui"
    depends on BR2_PACKAGE_SYSTEMD
    help
        Create hud user, sets up user session
```

## buildroot/br2_hudos/package/hudOS-deploy-user/Config.in
```kconfig
config BR2_PACKAGE_HUDOS_DEPLOY_USER
    bool "hudOS deploy user"
    help
        Create user account and ssh key for hud development
```

## buildroot/br2_hudos/package/hudOS-network/Config.in
```kconfig
config BR2_PACKAGE_HUDOS_NETWORK
    bool "hudOS network"
    depends on BR2_PACKAGE_SYSTEMD
    help
        Auto join WiFi

if BR2_PACKAGE_HUDOS_NETWORK
config BR2_PACKAGE_HUDOS_NETWORK_WIFI_SSID
    string
    prompt "SSID"
    help
        SSID for network

config BR2_PACKAGE_HUDOS_NETWORK_WIFI_PSK
    string
    prompt "Password"
    help
        Password for network

endif
```

## buildroot/br2_hudos/package/hudOS/Config.in
```kconfig
config BR2_PACKAGE_HUDOS
    bool "hudOS"
    depends on BR2_PACKAGE_SYSTEMD
    select BR2_PACKAGE_HUDCTL
    select BR2_PACKAGE_HUDOS_NETWORK
    select BR2_PACKAGE_HUDOS_FIRST_BOOT
    help
        HudOS base package
```

## buildroot/br2_hudos/package/hudctl/Config.in
```kconfig
config BR2_PACKAGE_HUDCTL
	bool "hudctl"
	depends on BR2_PACKAGE_HUD_FIRST_BOOT
	help
	    hudOS control
```

## buildroot/br2_hudos/package/japokwm/Config.in
```kconfig
config BR2_PACKAGE_JAPOKWM
	bool "japokwm"
    depends on BR2_PACKAGE_WLROOTS
    depends on BR2_PACKAGE_LUA
    depends on BR2_PACKAGE_LIBUV
    depends on BR2_PACKAGE_WAYLAND
    depends on BR2_PACKAGE_WAYLAND_PROTOCOLS
    depends on BR2_PACKAGE_MPFR
    depends on BR2_PACKAGE_JSON_C
	help
	    Japokwm is a dynamic tiling wayland compositor
```

## buildroot/br2_hudos/package/libnotify/Config.in
```kconfig
config BR2_PACKAGE_LIBNOTIFY
	bool "libnotify"
    depends on BR2_PACKAGE_GDK_PIXBUF
    depends on BR2_PACKAGE_LIBGTK3
	help
	    libnotify
```

## buildroot/configs/hudos_defconfig
```kconfig
BR2_aarch64=y
BR2_TOOLCHAIN_EXTERNAL=y
BR2_CCACHE=y
BR2_TARGET_GENERIC_HOSTNAME="hudOS"
BR2_TARGET_GENERIC_ISSUE="Welcome to hudOS"
BR2_INIT_SYSTEMD=y
# BR2_TARGET_ENABLE_ROOT_LOGIN is not set
BR2_SYSTEM_BIN_SH_BASH=y
# BR2_TARGET_GENERIC_GETTY is not set
BR2_TARGET_LOCALTIME="America/Los_Angeles"
BR2_ROOTFS_POST_IMAGE_SCRIPT="$(BR2_EXTERNAL_HUDOS_PATH)/board/pine64/pinephonepro/geninitramfs.sh support/scripts/genimage.sh"
BR2_ROOTFS_POST_SCRIPT_ARGS="-c $(BR2_EXTERNAL_HUDOS_PATH)/board/pine64/pinephonepro/genimage.cfg"
BR2_LINUX_KERNEL=y
BR2_LINUX_KERNEL_CUSTOM_GIT=y
BR2_LINUX_KERNEL_CUSTOM_REPO_URL="https://github.com/megous/linux.git"
BR2_LINUX_KERNEL_CUSTOM_REPO_VERSION="orange-pi-6.2"
BR2_LINUX_KERNEL_DEFCONFIG="pinephone_pro"
BR2_LINUX_KERNEL_IMAGEGZ=y
BR2_LINUX_KERNEL_DTS_SUPPORT=y
BR2_LINUX_KERNEL_INTREE_DTS_NAME="rockchip/rk3399-pinephone-pro"
BR2_PACKAGE_JQ=y
BR2_PACKAGE_MESA3D=y
BR2_PACKAGE_MESA3D_GALLIUM_DRIVER_PANFROST=y
BR2_PACKAGE_MESA3D_OSMESA_GALLIUM=y
BR2_PACKAGE_MESA3D_OPENGL_EGL=y
BR2_PACKAGE_MESA3D_OPENGL_ES=y
BR2_PACKAGE_VULKAN_HEADERS=y
BR2_PACKAGE_XKEYBOARD_CONFIG=y
BR2_PACKAGE_LVM2=y
BR2_PACKAGE_UBOOT_TOOLS=y
BR2_PACKAGE_UPOWER=y
BR2_PACKAGE_LUA=y
BR2_PACKAGE_LUA_CJSON=y
BR2_PACKAGE_GNUTLS=y
BR2_PACKAGE_LIBARGON2=y
BR2_PACKAGE_JPEG=y
BR2_PACKAGE_LIBGTK3=y
BR2_PACKAGE_WLROOTS=y
BR2_PACKAGE_LIBUSB=y
BR2_PACKAGE_JSON_C=y
BR2_PACKAGE_LIBFASTJSON=y
BR2_PACKAGE_LIBLOGGING=y
BR2_PACKAGE_LIBNDP=y
BR2_PACKAGE_LIBCAP_TOOLS=y
BR2_PACKAGE_LIBUV=y
BR2_PACKAGE_LINUX_PAM=y
BR2_PACKAGE_LLVM=y
BR2_PACKAGE_MPFR=y
BR2_PACKAGE_LIBESTR=y
BR2_PACKAGE_IPUTILS=y
BR2_PACKAGE_OPENSSH=y
BR2_PACKAGE_RSYNC=y
BR2_PACKAGE_WIRELESS_REGDB=y
BR2_PACKAGE_WPA_SUPPLICANT=y
BR2_PACKAGE_WPA_SUPPLICANT_WPA3=y
BR2_PACKAGE_WPA_SUPPLICANT_DBUS=y
BR2_PACKAGE_BASH_COMPLETION=y
BR2_PACKAGE_SUDO=y
BR2_PACKAGE_TIME=y
BR2_PACKAGE_WHICH=y
BR2_PACKAGE_ACL=y
BR2_PACKAGE_SEATD_BUILTIN=y
BR2_PACKAGE_SEATD_DAEMON=y
BR2_PACKAGE_SYSTEMD_BACKLIGHT=y
BR2_PACKAGE_TAR=y
BR2_PACKAGE_UTIL_LINUX_BINARIES=y
BR2_PACKAGE_UTIL_LINUX_HWCLOCK=y
BR2_PACKAGE_UTIL_LINUX_LOGGER=y
BR2_PACKAGE_UTIL_LINUX_PARTX=y
BR2_PACKAGE_UTIL_LINUX_SWITCH_ROOT=y
BR2_PACKAGE_VIM=y
BR2_TARGET_ROOTFS_EXT2=y
BR2_TARGET_ROOTFS_EXT2_4=y
BR2_TARGET_ROOTFS_EXT2_SIZE="300M"
# BR2_TARGET_ROOTFS_TAR is not set
BR2_PACKAGE_HOST_DTC=y
BR2_PACKAGE_HOST_GENEXT2FS=y
BR2_PACKAGE_HOST_GENIMAGE=y
BR2_PACKAGE_HOST_MTOOLS=y
BR2_PACKAGE_HOST_UBOOT_TOOLS=y
BR2_PACKAGE_HOST_UBOOT_TOOLS_BOOT_SCRIPT=y
BR2_PACKAGE_HOST_UBOOT_TOOLS_BOOT_SCRIPT_SOURCE="$(BR2_EXTERNAL_HUDOS_PATH)/board/pine64/pinephonepro/boot.txt"
BR2_PACKAGE_HUDOS=y
BR2_PACKAGE_HUDOS_DEPLOY_USER=y
BR2_PACKAGE_PINE_FIRMWARE=y
BR2_PACKAGE_PINE_FIRMWARE_ROCKCHIP_DPTX=y
BR2_PACKAGE_PINE_FIRMWARE_BCM43=y
BR2_PACKAGE_KIWMI=y
```

## buildroot/package/envsubst/Config.in
```kconfig
config BR2_PACKAGE_ENVSUBST
	depends on BR2_PACKAGE_HOST_GO_TARGET_ARCH_SUPPORTS
	bool "envsubst"
	help
		go implementation of envsubst
```

## buildroot/package/hudOS-first-boot/Config.in
```kconfig
config BR2_PACKAGE_HUDOS_FIRST_BOOT
	bool "hudOS first-boot"
	depends on BR2_PACKAGE_HUDOS
	help
	    Runs all scripts under /opt/hud/firstboot when hudOS boots for the first time
```

## buildroot/package/hudctl/Config.in
```kconfig
config BR2_PACKAGE_HUDCTL
	bool "hudctl"
	depends on BR2_PACKAGE_HUDOS_FIRST_BOOT
	select BR2_PACKAGE_ENVSUBST
	help
	    hudOS control
```

## buildroot/package/japokwm/Config.in
```kconfig
config BR2_PACKAGE_JAPOKWM
	bool "japokwm"
    depends on BR2_PACKAGE_WLROOTS
    depends on BR2_PACKAGE_LUA
    depends on BR2_PACKAGE_LIBUV
    depends on BR2_PACKAGE_WAYLAND
    depends on BR2_PACKAGE_WAYLAND_PROTOCOLS
    depends on BR2_PACKAGE_MPFR
    depends on BR2_PACKAGE_JSON_C
    depends on BR2_PACKAGE_XORG7
    depends on BR2_PACKAGE_LIBNOTIFY
	help
	    Japokwm is a dynamic tiling wayland compositor
```

## buildroot/package/kiwmi/Config.in
```kconfig
config BR2_PACKAGE_KIWMI
	bool "kiwmi"
	depends on BR2_PACKAGE_WLROOTS
	depends on BR2_PACKAGE_LUA
	depends on BR2_PACKAGE_PIXMAN
	help
		A fully programmable Wayland Compositor
```

## buildroot/package/pine-firmware/Config.in
```kconfig
config BR2_PACKAGE_PINE_FIRMWARE
	bool "pine-firmware"
	help
	    Provides firmware from megi's linux-firmware tree

if BR2_PACKAGE_PINE_FIRMWARE

config BR2_PACKAGE_PINE_FIRMWARE_ROCKCHIP_DPTX
    bool "Rockchip dptx"
    help
        Firmware for display port maybe?

config BR2_PACKAGE_PINE_FIRMWARE_BCM43
    bool "BCM43 chips"
    help
        Firmware for Broadcom BCM43

config BR2_PACKAGE_PINE_FIRMWARE_ANX7688
    bool "ANX7688 HDMI to USB Type-C Bridge"
    help
        Firmware files for Analogix ANX7688

config BR2_PACKAGE_PINE_FIRMWARE_OV5640
    bool "OV5640 Camera"
    help
        Firmware file for OmniVision OV5460 Camera (rear camera)

config BR2_PACKAGE_PINE_FIRMWARE_RTL8723CS
    bool "RTL8723CS WiFi/Bluetooth"
    help
        Firmware for Realtek RTL8723CS

endif
```
